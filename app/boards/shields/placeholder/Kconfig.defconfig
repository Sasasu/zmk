## app/boards/shields/placeholder/Kconfig.defconfig
```kconfig
# Copyright (c) 2020 The ZMK Contributors
# SPDX-License-Identifier: MIT

if SHIELD_PLACEHOLDER

config ZMK_KEYBOARD_NAME
	default "placeholder"

endif
```

## app/boards/shields/placeholder/Kconfig.shield
```kconfig
# Copyright (c) 2020 The ZMK Contributors
# SPDX-License-Identifier: MIT

config SHIELD_PLACEHOLDER
   bool "Placeholder"
   depends on BOARD_RPI_PICO
```

## app/west.yml
```yaml
manifest:
  remotes:
    - name: zephyrproject-rtos
      url-base: https://github.com/zephyrproject-rtos
    - name: zmkfirmware
      url-base: https://github.com/zmkfirmware
    - name: sasasu
      url-base: https://github.com/Sasasu
  projects:
    - name: zephyr
      remote: sasasu
      revision: main
      clone-depth: 1
      import:
        # TODO: Rename once upstream offers option like `exclude` or `denylist`
        name-blacklist:
          - ci-tools
          - hal_altera
          - hal_cypress
          - hal_infineon
          - hal_microchip
          - hal_nxp
          - hal_openisa
          - hal_silabs
          - hal_xtensa
          - hal_st
          - hal_ti
          - loramac-node
          - mcuboot
          - mcumgr
          - net-tools
          - openthread
          - edtt
          - trusted-firmware-m
          - sof
  self:
    west-commands: scripts/west-commands.yml
```
